#pragma once
#include "osdp_defs.h"

// ─── Compact AES-128 ECB (software, no hardware crypto on F103) ──
static const uint8_t _sb[256] = {
  0x63,0x7c,0x77,0x7b,0xf2,0x6b,0x6f,0xc5,0x30,0x01,0x67,0x2b,0xfe,0xd7,0xab,0x76,
  0xca,0x82,0xc9,0x7d,0xfa,0x59,0x47,0xf0,0xad,0xd4,0xa2,0xaf,0x9c,0xa4,0x72,0xc0,
  0xb7,0xfd,0x93,0x26,0x36,0x3f,0xf7,0xcc,0x34,0xa5,0xe5,0xf1,0x71,0xd8,0x31,0x15,
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  0x8c,0xa1,0x89,0x0d,0xbf,0xe6,0x42,0x68,0x41,0x99,0x2d,0x0f,0xb0,0x54,0xbb,0x16};
static const uint8_t _rsb[256] = {
  0x52,0x09,0x6a,0xd5,0x30,0x36,0xa5,0x38,0xbf,0x40,0xa3,0x9e,0x81,0xf3,0xd7,0xfb,
  0x7c,0xe3,0x39,0x82,0x9b,0x2f,0xff,0x87,0x34,0x8e,0x43,0x44,0xc4,0xde,0xe9,0xcb,
  0x54,0x7b,0x94,0x32,0xa6,0xc2,0x23,0x3d,0xee,0x4c,0x95,0x0b,0x42,0xfa,0xc3,0x4e,
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  0x17,0x2b,0x04,0x7e,0xba,0x77,0xd6,0x26,0xe1,0x69,0x14,0x63,0x55,0x21,0x0c,0x7d};
static const uint8_t _rc[11] = {0x8d,1,2,4,8,0x10,0x20,0x40,0x80,0x1b,0x36};
static inline uint8_t _xt(uint8_t x){return(x<<1)^(((x>>7)&1)*0x1b);}

static void _kexp(uint8_t *rk, const uint8_t *key){
    memcpy(rk,key,16);
    for(int i=4;i<44;i++){uint8_t t[4];memcpy(t,rk+(i-1)*4,4);
    if(i%4==0){uint8_t tmp=t[0];t[0]=_sb[t[1]]^_rc[i/4];t[1]=_sb[t[2]];t[2]=_sb[t[3]];t[3]=_sb[tmp];}
    for(int j=0;j<4;j++)rk[i*4+j]=rk[(i-4)*4+j]^t[j];}
}
static void _aesE(uint8_t *s, const uint8_t *rk){
    for(int i=0;i<16;i++)s[i]^=rk[i];
    for(int r=1;r<=10;r++){
        for(int i=0;i<16;i++)s[i]=_sb[s[i]];
        uint8_t t;
        t=s[1];s[1]=s[5];s[5]=s[9];s[9]=s[13];s[13]=t;
        t=s[2];s[2]=s[10];s[10]=t;t=s[6];s[6]=s[14];s[14]=t;
        t=s[15];s[15]=s[11];s[11]=s[7];s[7]=s[3];s[3]=t;
        if(r<10){for(int i=0;i<4;i++){uint8_t*c=s+i*4;
            uint8_t a0=c[0],a1=c[1],a2=c[2],a3=c[3];
            c[0]=_xt(a0)^_xt(a1)^a1^a2^a3;c[1]=a0^_xt(a1)^_xt(a2)^a2^a3;
            c[2]=a0^a1^_xt(a2)^_xt(a3)^a3;c[3]=_xt(a0)^a0^a1^a2^_xt(a3);}}
        for(int i=0;i<16;i++)s[i]^=rk[r*16+i];}
}
static void _aesD(uint8_t *s, const uint8_t *rk){
    for(int i=0;i<16;i++)s[i]^=rk[160+i];
    for(int r=9;r>=0;r--){
        uint8_t t;
        t=s[13];s[13]=s[9];s[9]=s[5];s[5]=s[1];s[1]=t;
        t=s[2];s[2]=s[10];s[10]=t;t=s[6];s[6]=s[14];s[14]=t;
        t=s[3];s[3]=s[7];s[7]=s[11];s[11]=s[15];s[15]=t;
        for(int i=0;i<16;i++)s[i]=_rsb[s[i]];
        for(int i=0;i<16;i++)s[i]^=rk[r*16+i];
        if(r>0){for(int i=0;i<4;i++){uint8_t*c=s+i*4;
            uint8_t a0=c[0],a1=c[1],a2=c[2],a3=c[3];
            uint8_t x0=_xt(a0),x1=_xt(a1),x2=_xt(a2),x3=_xt(a3);
            uint8_t y0=_xt(x0),y1=_xt(x1),y2=_xt(x2),y3=_xt(x3);
            uint8_t z0=_xt(y0),z1=_xt(y1),z2=_xt(y2),z3=_xt(y3);
            c[0]=z0^y0^x0^z1^x1^a1^z2^y2^a2^z3^a3;
            c[1]=z0^a0^z1^y1^x1^z2^x2^a2^z3^y3^a3;
            c[2]=z0^y0^a0^z1^a1^z2^y2^x2^z3^x3^a3;
            c[3]=z0^x0^a0^z1^y1^a1^z2^a2^z3^y3^x3;}}}
}
static void aesEnc(uint8_t *d, const uint8_t *k){uint8_t rk[176];_kexp(rk,k);_aesE(d,rk);}
static void aesDec(uint8_t *d, const uint8_t *k){uint8_t rk[176];_kexp(rk,k);_aesD(d,rk);}

// ─── CRC16-CCITT (poly=0x1021, init=0x1D0F) ─────────────────────
static uint16_t osdpCrc16(const uint8_t *d, uint16_t len){
    uint16_t crc=0x1D0F;
    for(uint16_t i=0;i<len;i++){crc^=((uint16_t)d[i]<<8);
    for(int j=0;j<8;j++)crc=(crc&0x8000)?((crc<<1)^0x1021):(crc<<1);}
    return crc;
}
static uint8_t osdpChecksum(const uint8_t *d, uint16_t len){
    uint16_t s=0;for(uint16_t i=0;i<len;i++)s+=d[i];return(uint8_t)(~s+1);
}

// ─── OSDP session key derivation / crypto ────────────────────────
static void deriveSessionKeys(uint8_t *sEnc, uint8_t *sMac1, uint8_t *sMac2,
                               const uint8_t *scbk, const uint8_t *rndA,
                               uint8_t sEncTag = 0x04){
    uint8_t b[16];
    auto mk=[&](uint8_t tag){b[0]=1;b[1]=tag;memcpy(b+2,rndA,6);memset(b+8,0,8);};
    mk(sEncTag);aesEnc(b,scbk);memcpy(sEnc,b,16);
    mk(0x01);aesEnc(b,scbk);memcpy(sMac1,b,16);
    mk(0x02);aesEnc(b,scbk);memcpy(sMac2,b,16);
}
static void computeCryptogram(uint8_t *out,const uint8_t *a,const uint8_t *b,const uint8_t *k){
    uint8_t t[16];memcpy(t,a,8);memcpy(t+8,b,8);aesEnc(t,k);memcpy(out,t,16);
}
static uint8_t padMsg(uint8_t *buf,uint16_t len){
    uint8_t n=len/16,r=len%16;
    buf[n*16+r]=0x80;
    for(uint8_t i=1;i<16-r;i++)buf[n*16+r+i]=0;
    if(r==0)memset(buf+n*16+1,0,15);
    n++;
    return n;
}
static void computeMac(uint8_t *mo,const uint8_t *msg,uint16_t ml,
                        const uint8_t *icv,const uint8_t *m1,const uint8_t *m2){
    uint8_t p[512];memcpy(p,msg,ml);uint8_t n=padMsg(p,ml);
    if(!n){memset(mo,0,16);return;}
    uint8_t c[16];memcpy(c,icv,16);
    for(uint8_t i=0;i<n;i++){for(int j=0;j<16;j++)c[j]^=p[i*16+j];aesEnc(c,(i<n-1)?m1:m2);}
    memcpy(mo,c,16);
}
static void computeRmacI(uint8_t *out,const uint8_t *sc,const uint8_t *m1,const uint8_t *m2){
    uint8_t iv[16]={0};
    computeMac(out,sc,16,iv,m1,m2);
}
static uint8_t encryptData(uint8_t *out,const uint8_t *d,uint16_t l,const uint8_t *k,const uint8_t *iv){
    if(!l)return 0;uint8_t p[256];memcpy(p,d,l);uint8_t n=padMsg(p,l);
    uint8_t c[16];memcpy(c,iv,16);
    for(uint8_t i=0;i<n;i++){for(int j=0;j<16;j++)p[i*16+j]^=c[j];aesEnc(&p[i*16],k);memcpy(c,&p[i*16],16);}
    memcpy(out,p,n*16);return n;
}
static uint8_t decryptData(uint8_t *out,const uint8_t *d,uint16_t l,const uint8_t *k,const uint8_t *iv){
    if(!l||l%16)return 0;uint8_t n=l/16,c[16],pr[16],b[16];
    memcpy(c,iv,16);
    for(uint8_t i=0;i<n;i++){memcpy(pr,&d[i*16],16);memcpy(b,&d[i*16],16);aesDec(b,k);
    for(int j=0;j<16;j++)out[i*16+j]=b[j]^c[j];memcpy(c,pr,16);}
    uint16_t rl=n*16;while(rl>0&&out[rl-1]==0)rl--;if(rl>0&&out[rl-1]==0x80)rl--;return rl;
}
static void randBytes(uint8_t *buf, int n){
    for(int i=0;i<n;i++){buf[i]=(uint8_t)((analogRead(PA4)^(millis()>>(i&3))^micros())&0xFF);delayMicroseconds(1);}
}
